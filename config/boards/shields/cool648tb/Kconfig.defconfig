## config/boards/shields/cool648tb/Kconfig.defconfig
```kconfig
if SHIELD_COOL648TB_R

config ZMK_KEYBOARD_NAME
    default "cool648tb_R"

config ZMK_SPLIT
    default y

config ZMK_SPLIT_ROLE_CENTRAL
    default y

endif

if SHIELD_COOL648TB_L

config ZMK_KEYBOARD_NAME
    default "cool648tb_L"

config ZMK_SPLIT
    default y

endif
```

## config/boards/shields/cool648tb/Kconfig.shield
```kconfig
config SHIELD_COOL648TB_R
    def_bool $(shields_list_contains,cool648tb_R)

config SHIELD_COOL648TB_L
    def_bool $(shields_list_contains,cool648tb_L)
```
